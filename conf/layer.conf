## conf/layer.conf
```bitbake
BBPATH =. "${LAYERDIR}:"
BBFILES += "${LAYERDIR}/recipes-*/*/*.bb \
            ${LAYERDIR}/recipes-*/*/*.bbappend"
BBFILE_COLLECTIONS += "hablayer"
BBFILE_PATTERN_hablayer = "^${LAYERDIR}/"
BBFILE_PATTERN_IGNORE_EMPTY_hablayer = "1"
BBFILE_PRIORITY_hablayer = "99"

# Enable if u-boot-compulab is not included in the project
#BBMASK += " u-boot-compulab_%.bbappend "
# Enable if linux-compulab is not included in the project
#BBMASK += " linux-compulab_%.bbappend "

LAYERSERIES_COMPAT_hablayer = "scarthgap"

HOSTTOOLS += " hexdump awk xxd "

CORE_IMAGE_EXTRA_INSTALL += " cst-tools "

INHERIT += "compulab-hab"
ROOTFS_POSTPROCESS_COMMAND += "${@bb.utils.contains('DISTRO_FEATURES', 'compulab-uefi', 'compulab_bootaa64_efi; ', '', d)}"
ROOTFS_POSTPROCESS_COMMAND += "compulab_kernel_image; "
```
